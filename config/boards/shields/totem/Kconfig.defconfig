## config/boards/shields/totem/Kconfig.defconfig
```kconfig
# Copyright (c) 2022 The ZMK Contributors
# SPDX-License-Identifier: MIT

if SHIELD_TOTEM_LEFT || SHIELD_TOTEM_DONGLE_NANO

config ZMK_KEYBOARD_NAME
    default "TOTEM"
    
config ZMK_SPLIT_ROLE_CENTRAL
    default y

endif

if SHIELD_TOTEM_LEFT || SHIELD_TOTEM_RIGHT || SHIELD_TOTEM_PERIPHERAL_LEFT || SHIELD_TOTEM_DONGLE_NANO

config ZMK_SPLIT
    default y

endif

if ZMK_DISPLAY

config I2C
    default y

config SSD1306
    default y

if SHIELD_TOTEM_DONGLE_XIAO
  
choice ZMK_DISPLAY_WORK_QUEUE
    default ZMK_DISPLAY_WORK_QUEUE_DEDICATED
endchoice

endif

endif # ZMK_DISPLAY
```

## config/west.yml
```yaml
manifest:
  remotes:
    - name: upstream
      url-base: https://github.com/zmkfirmware
    - name: urob
      url-base: https://github.com/urob
    - name: caksoylar
      url-base: https://github.com/caksoylar
    - name: m165437 
      url-base: https://github.com/M165437

  projects:
    - name: zmk
      remote: urob
      revision: main
      import: app/west.yml
    - name: zmk-rgbled-widget
      remote: caksoylar
      revision: main
    - name: zmk-helpers
      remote: urob
      revision: main
    - name: nice-view-gem
      remote: m165437
      revision: main

  self:
    path: config
```
